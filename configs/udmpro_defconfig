## configs/udmpro_defconfig
```kconfig
#
# secfirstgw-rs: Linux 6.12 LTS defconfig for Ubiquiti UDM Pro
#
# Target: Ubiquiti UDM Pro (UniFi Dream Machine Pro)
# SoC:    Annapurna Labs Alpine V2 (Amazon AL-314, 4x Cortex-A57)
# RAM:    4 GB DDR4
# Storage: 1x SATA bay (via AHCI), eMMC (via xHCI/ASMedia)
# Network: 2x 1GbE + 2x 10G SFP+ (al_eth), RTL8370MB 8-port switch
# Flash:  SPI NOR (M25P80, for U-Boot env)
# I2C:    DesignWare, PCA9546 mux, PCA9575 GPIO
# Display: LCM front panel via USB serial (ttyACM0)
# PCIe:   Annapurna Labs (DesignWare-based), Alpine MSI
#
# Based on UNVR defconfig with additional networking features:
# - WireGuard VPN
# - Full nftables/netfilter stack
# - Bridge + VLAN 802.1Q
# - Traffic shaping (QoS)
# - IFB (Intermediate Functional Block) for ingress QoS
# - USB ACM (for LCM display)
#
# The al_eth network driver is NOT included here — it is built as an
# out-of-tree module against this kernel.
#

# ----------------------------------------------------------------------
# General setup
# ----------------------------------------------------------------------
CONFIG_SYSVIPC=y
CONFIG_POSIX_MQUEUE=y
CONFIG_AUDIT=y
CONFIG_NO_HZ_IDLE=y
CONFIG_HIGH_RES_TIMERS=y
CONFIG_PREEMPT_VOLUNTARY=y
CONFIG_BSD_PROCESS_ACCT=y
CONFIG_BSD_PROCESS_ACCT_V3=y
CONFIG_TASKSTATS=y
CONFIG_TASK_DELAY_ACCT=y
CONFIG_TASK_XACCT=y
CONFIG_TASK_IO_ACCOUNTING=y
CONFIG_IKCONFIG=y
CONFIG_IKCONFIG_PROC=y
CONFIG_LOG_BUF_SHIFT=17
CONFIG_CGROUPS=y
CONFIG_MEMCG=y
CONFIG_BLK_CGROUP=y
CONFIG_CGROUP_SCHED=y
CONFIG_CFS_BANDWIDTH=y
CONFIG_CGROUP_FREEZER=y
CONFIG_CPUSETS=y
CONFIG_CGROUP_DEVICE=y
CONFIG_CGROUP_CPUACCT=y
CONFIG_CGROUP_PIDS=y
CONFIG_NAMESPACES=y
CONFIG_USER_NS=y
CONFIG_BLK_DEV_INITRD=y
CONFIG_CC_OPTIMIZE_FOR_PERFORMANCE=y
CONFIG_KALLSYMS=y
CONFIG_KALLSYMS_ALL=y
CONFIG_BPF_SYSCALL=y
CONFIG_USERFAULTFD=y

# ----------------------------------------------------------------------
# ARM64 platform
# ----------------------------------------------------------------------
CONFIG_ARCH_ALPINE=y
CONFIG_ARM64_VA_BITS_48=y
CONFIG_NR_CPUS=4
CONFIG_HOTPLUG_CPU=y
CONFIG_HZ_250=y
CONFIG_ARM64_ERRATUM_826319=y
CONFIG_ARM64_ERRATUM_827319=y
CONFIG_ARM64_ERRATUM_824069=y
CONFIG_ARM64_ERRATUM_819472=y
CONFIG_ARM64_ERRATUM_832075=y
CONFIG_ARM64_ERRATUM_843419=y
CONFIG_ARM64_ERRATUM_1024718=y

# Hardening
CONFIG_RANDOMIZE_BASE=y
CONFIG_STACKPROTECTOR=y
CONFIG_STACKPROTECTOR_STRONG=y
CONFIG_VMAP_STACK=y

# ARM64 Power management
CONFIG_ARM_PSCI_FW=y
CONFIG_CPU_IDLE=y
CONFIG_ARM_CPUIDLE=y

# ----------------------------------------------------------------------
# Kernel features
# ----------------------------------------------------------------------
CONFIG_TRANSPARENT_HUGEPAGE=y
CONFIG_TRANSPARENT_HUGEPAGE_MADVISE=y
CONFIG_COMPACTION=y
CONFIG_SWAP=y

# ----------------------------------------------------------------------
# Modules
# ----------------------------------------------------------------------
CONFIG_MODULES=y
CONFIG_MODULE_UNLOAD=y
CONFIG_MODVERSIONS=y

# ----------------------------------------------------------------------
# Block layer
# ----------------------------------------------------------------------
CONFIG_BLK_DEV_BSG=y
CONFIG_BLK_DEV_BSGLIB=y
CONFIG_BLK_DEV_INTEGRITY=y
CONFIG_BLK_DEV_THROTTLING=y
CONFIG_PARTITION_ADVANCED=y
CONFIG_MSDOS_PARTITION=y
CONFIG_EFI_PARTITION=y

# IO scheduler
CONFIG_IOSCHED_BFQ=y

# ----------------------------------------------------------------------
# Executable format
# ----------------------------------------------------------------------
CONFIG_BINFMT_ELF=y
CONFIG_BINFMT_SCRIPT=y
CONFIG_COREDUMP=y

# ----------------------------------------------------------------------
# Networking
# ----------------------------------------------------------------------
CONFIG_NET=y
CONFIG_PACKET=y
CONFIG_UNIX=y
CONFIG_INET=y
CONFIG_IP_MULTICAST=y
CONFIG_IP_PNP=y
CONFIG_IP_PNP_DHCP=y
CONFIG_IP_PNP_BOOTP=y
CONFIG_SYN_COOKIES=y
CONFIG_NET_IPIP=m
CONFIG_NET_IP_TUNNEL=m
CONFIG_INET_ESP=m
CONFIG_INET_AH=m
CONFIG_TCP_CONG_CUBIC=y

# IPv6
CONFIG_IPV6=y
CONFIG_IPV6_MULTIPLE_TABLES=y
CONFIG_IPV6_SUBTREES=y
CONFIG_INET6_AH=m
CONFIG_INET6_ESP=m
CONFIG_IPV6_SIT=m

# Netfilter — full stack for gateway firewall
CONFIG_NETFILTER=y
CONFIG_NETFILTER_ADVANCED=y
CONFIG_NF_CONNTRACK=m
CONFIG_NF_CONNTRACK_MARK=y
CONFIG_NF_CONNTRACK_ZONES=y
CONFIG_NF_CONNTRACK_EVENTS=y
CONFIG_NF_TABLES=m
CONFIG_NF_TABLES_INET=y
CONFIG_NF_TABLES_BRIDGE=m
CONFIG_NFT_CT=m
CONFIG_NFT_LOG=m
CONFIG_NFT_LIMIT=m
CONFIG_NFT_NAT=m
CONFIG_NFT_MASQ=m
CONFIG_NFT_REDIR=m
CONFIG_NFT_REJECT=m
CONFIG_NFT_COMPAT=m
CONFIG_NFT_COUNTER=m
CONFIG_NFT_QUOTA=m
CONFIG_NFT_FIB_INET=m
CONFIG_NFT_FIB_IPV4=m
CONFIG_NFT_FIB_IPV6=m
CONFIG_NETFILTER_XT_MATCH_CONNTRACK=m
CONFIG_NETFILTER_XT_MATCH_STATE=m
CONFIG_NETFILTER_XT_MATCH_MARK=m
CONFIG_NETFILTER_XT_MATCH_LIMIT=m
CONFIG_NETFILTER_XT_MATCH_MULTIPORT=m
CONFIG_NETFILTER_XT_MATCH_COMMENT=m
CONFIG_NETFILTER_XT_MATCH_MAC=m
CONFIG_NETFILTER_XT_MATCH_IPRANGE=m
CONFIG_NETFILTER_XT_TARGET_LOG=m
CONFIG_NETFILTER_XT_TARGET_MARK=m
CONFIG_NETFILTER_XT_TARGET_CLASSIFY=m
CONFIG_NF_NAT=m
CONFIG_IP_NF_IPTABLES=m
CONFIG_IP_NF_FILTER=m
CONFIG_IP_NF_TARGET_REJECT=m
CONFIG_IP_NF_NAT=m
CONFIG_IP_NF_TARGET_MASQUERADE=m
CONFIG_IP_NF_MANGLE=m
CONFIG_IP_NF_TARGET_REDIRECT=m
CONFIG_IP6_NF_IPTABLES=m
CONFIG_IP6_NF_FILTER=m
CONFIG_IP6_NF_TARGET_REJECT=m
CONFIG_IP6_NF_NAT=m
CONFIG_IP6_NF_TARGET_MASQUERADE=m
CONFIG_IP6_NF_MANGLE=m

# Bridge (for VLAN zones)
CONFIG_BRIDGE=y
CONFIG_BRIDGE_NETFILTER=m
CONFIG_BRIDGE_VLAN_FILTERING=y
CONFIG_VLAN_8021Q=y

# WireGuard VPN
CONFIG_WIREGUARD=m

# Traffic shaping / QoS
CONFIG_NET_SCHED=y
CONFIG_NET_SCH_HTB=m
CONFIG_NET_SCH_FQ_CODEL=y
CONFIG_NET_SCH_INGRESS=m
CONFIG_NET_SCH_TBF=m
CONFIG_NET_SCH_SFQ=m
CONFIG_NET_SCH_PRIO=m
CONFIG_NET_CLS_FW=m
CONFIG_NET_CLS_U32=m
CONFIG_NET_CLS_ACT=y
CONFIG_NET_ACT_MIRRED=m
CONFIG_NET_ACT_POLICE=m
CONFIG_IFB=m

# Conntrack helpers
CONFIG_NF_CONNTRACK_FTP=m
CONFIG_NF_CONNTRACK_TFTP=m
CONFIG_NF_CONNTRACK_SIP=m

# DNS resolver
CONFIG_DNS_RESOLVER=y

# ----------------------------------------------------------------------
# Device drivers
# ----------------------------------------------------------------------

# Bus
CONFIG_ARM_AMBA=y

# Device core
CONFIG_DEVTMPFS=y
CONFIG_DEVTMPFS_MOUNT=y
CONFIG_FW_LOADER=y

# OF / Device tree
CONFIG_OF=y
CONFIG_OF_MDIO=y

# Regmap
CONFIG_REGMAP=y
CONFIG_REGMAP_I2C=y
CONFIG_REGMAP_SPI=y
CONFIG_REGMAP_MMIO=y

# ----------------------------------------------------------------------
# MTD / SPI flash
# ----------------------------------------------------------------------
CONFIG_MTD=y
CONFIG_MTD_OF_PARTS=y
CONFIG_MTD_BLOCK=y
CONFIG_MTD_SPI_NOR=y
CONFIG_MTD_SPI_NOR_USE_4K_SECTORS=y

# ----------------------------------------------------------------------
# Block devices
# ----------------------------------------------------------------------
CONFIG_BLK_DEV=y
CONFIG_BLK_DEV_LOOP=m
CONFIG_BLK_DEV_LOOP_MIN_COUNT=8
CONFIG_BLK_DEV_RAM=m
CONFIG_BLK_DEV_RAM_COUNT=1
CONFIG_BLK_DEV_RAM_SIZE=4096

# ----------------------------------------------------------------------
# SCSI
# ----------------------------------------------------------------------
CONFIG_SCSI=y
CONFIG_BLK_DEV_SD=y
CONFIG_CHR_DEV_SG=y
CONFIG_SCSI_SAS_ATTRS=y
CONFIG_SCSI_SAS_LIBSAS=y

# ----------------------------------------------------------------------
# SATA / AHCI
# ----------------------------------------------------------------------
CONFIG_ATA=y
CONFIG_ATA_VERBOSE_ERROR=y
CONFIG_SATA_AHCI=y
CONFIG_SATA_AHCI_PLATFORM=y

# ----------------------------------------------------------------------
# MD / RAID / Device Mapper
# ----------------------------------------------------------------------
CONFIG_MD=y
CONFIG_BLK_DEV_MD=m
CONFIG_MD_RAID0=m
CONFIG_MD_RAID1=m
CONFIG_MD_RAID10=m
CONFIG_MD_RAID456=m
CONFIG_BLK_DEV_DM=m
CONFIG_DM_CRYPT=m
CONFIG_DM_VERITY=m

# ----------------------------------------------------------------------
# Network device drivers
# ----------------------------------------------------------------------
CONFIG_NETDEVICES=y
CONFIG_ETHERNET=y
# al_eth is out-of-tree — we just need PHY / MDIO support
CONFIG_MDIO_DEVICE=y
CONFIG_MDIO_BUS=y
CONFIG_PHYLINK=m
CONFIG_PHYLIB=y
CONFIG_FIXED_PHY=y
CONFIG_REGULATOR=y
CONFIG_REGULATOR_FIXED_VOLTAGE=y
CONFIG_AT803X_PHY=y
CONFIG_MARVELL_PHY=m
CONFIG_MARVELL_10G_PHY=m
CONFIG_REALTEK_PHY=y

# DSA (Distributed Switch Architecture) for RTL8370MB managed switch
CONFIG_NET_DSA=y
CONFIG_NET_DSA_REALTEK=y
CONFIG_NET_DSA_REALTEK_MDIO=y
CONFIG_NET_DSA_REALTEK_SMI=y
CONFIG_NET_DSA_REALTEK_RTL8365MB=y

# No wireless on gateway (no built-in AP on UDM Pro)
# CONFIG_WLAN is not set
# CONFIG_BT is not set

# ----------------------------------------------------------------------
# Serial / Console
# ----------------------------------------------------------------------
CONFIG_TTY=y
CONFIG_VT=y
CONFIG_VT_CONSOLE=y
CONFIG_UNIX98_PTYS=y
CONFIG_SERIAL_EARLYCON=y
CONFIG_SERIAL_8250=y
CONFIG_SERIAL_8250_CONSOLE=y
CONFIG_SERIAL_8250_DMA=y
CONFIG_SERIAL_8250_NR_UARTS=4
CONFIG_SERIAL_8250_RUNTIME_UARTS=4
CONFIG_SERIAL_8250_EXTENDED=y
CONFIG_SERIAL_8250_SHARE_IRQ=y
CONFIG_SERIAL_8250_DW=y
CONFIG_SERIAL_OF_PLATFORM=y

# Hardware RNG
CONFIG_HW_RANDOM=y

# ----------------------------------------------------------------------
# I2C
# ----------------------------------------------------------------------
CONFIG_I2C=y
CONFIG_I2C_CHARDEV=y
CONFIG_I2C_MUX=y
CONFIG_I2C_MUX_PCA954x=y
CONFIG_I2C_DESIGNWARE_CORE=y
CONFIG_I2C_DESIGNWARE_PLATFORM=y

# ----------------------------------------------------------------------
# SPI
# ----------------------------------------------------------------------
CONFIG_SPI=y
CONFIG_SPI_MASTER=y
CONFIG_SPI_MEM=y
CONFIG_SPI_DESIGNWARE=y
CONFIG_SPI_DW_MMIO=y
CONFIG_SPI_SPIDEV=y

# ----------------------------------------------------------------------
# PPS / PTP
# ----------------------------------------------------------------------
CONFIG_PPS=y
CONFIG_PTP_1588_CLOCK=y

# ----------------------------------------------------------------------
# GPIO
# ----------------------------------------------------------------------
CONFIG_GPIOLIB=y
CONFIG_OF_GPIO=y
CONFIG_GPIOLIB_IRQCHIP=y
CONFIG_GPIO_SYSFS=y
CONFIG_GPIO_GENERIC_PLATFORM=y
CONFIG_GPIO_PL061=y
CONFIG_GPIO_DWAPB=y
CONFIG_GPIO_PCA953X=y
CONFIG_GPIO_PCA953X_IRQ=y

# ----------------------------------------------------------------------
# Power supply / reset
# ----------------------------------------------------------------------
CONFIG_POWER_SUPPLY=y
CONFIG_POWER_RESET=y
CONFIG_POWER_RESET_GPIO=y
CONFIG_POWER_RESET_GPIO_RESTART=y
CONFIG_POWER_RESET_SYSCON=y
CONFIG_POWER_RESET_SYSCON_POWEROFF=y

# ----------------------------------------------------------------------
# Hardware monitoring
# ----------------------------------------------------------------------
CONFIG_HWMON=y
CONFIG_SENSORS_ADT7475=y
CONFIG_SENSORS_LM63=y

# ----------------------------------------------------------------------
# Thermal
# ----------------------------------------------------------------------
CONFIG_THERMAL=y
CONFIG_THERMAL_HWMON=y
CONFIG_THERMAL_OF=y
CONFIG_THERMAL_DEFAULT_GOV_STEP_WISE=y
CONFIG_THERMAL_GOV_STEP_WISE=y

# ----------------------------------------------------------------------
# Watchdog
# ----------------------------------------------------------------------
CONFIG_WATCHDOG=y
CONFIG_WATCHDOG_CORE=y
CONFIG_ARM_SP805_WATCHDOG=y

# ----------------------------------------------------------------------
# MFD
# ----------------------------------------------------------------------
CONFIG_MFD_SYSCON=y

# ----------------------------------------------------------------------
# LEDs
# ----------------------------------------------------------------------
CONFIG_NEW_LEDS=y
CONFIG_LEDS_CLASS=y
CONFIG_LEDS_GPIO=y
CONFIG_LEDS_TRIGGERS=y
CONFIG_LEDS_TRIGGER_TIMER=y
CONFIG_LEDS_TRIGGER_HEARTBEAT=y
CONFIG_LEDS_TRIGGER_DEFAULT_ON=y
CONFIG_LEDS_TRIGGER_DISK=y

# ----------------------------------------------------------------------
# Input
# ----------------------------------------------------------------------
CONFIG_INPUT=y
CONFIG_INPUT_EVDEV=y
CONFIG_INPUT_KEYBOARD=y
CONFIG_KEYBOARD_GPIO=y

# ----------------------------------------------------------------------
# RTC
# ----------------------------------------------------------------------
CONFIG_RTC_CLASS=y
CONFIG_RTC_HCTOSYS=y
CONFIG_RTC_DRV_DS1307=y
CONFIG_RTC_DRV_S35390A=y

# ----------------------------------------------------------------------
# EEPROM
# ----------------------------------------------------------------------
CONFIG_EEPROM_AT24=y

# ----------------------------------------------------------------------
# USB
# ----------------------------------------------------------------------
CONFIG_USB_SUPPORT=y
CONFIG_USB=y
CONFIG_USB_XHCI_HCD=y
CONFIG_USB_XHCI_PCI=y
CONFIG_USB_XHCI_PLATFORM=y
CONFIG_USB_EHCI_HCD=y
CONFIG_USB_EHCI_PCI=y
CONFIG_USB_EHCI_HCD_PLATFORM=y
CONFIG_USB_OHCI_HCD=y
CONFIG_USB_OHCI_HCD_PCI=y
CONFIG_USB_OHCI_HCD_PLATFORM=y
CONFIG_USB_STORAGE=y
CONFIG_USB_SERIAL=y
CONFIG_USB_SERIAL_CP210X=y
CONFIG_USB_SERIAL_FTDI_SIO=y
# USB ACM — LCM front panel display on UDM Pro (/dev/ttyACM0)
CONFIG_USB_ACM=y

# ----------------------------------------------------------------------
# PCI
# ----------------------------------------------------------------------
CONFIG_PCI=y
CONFIG_PCI_MSI=y
CONFIG_PCIEPORTBUS=y
CONFIG_PCIE_AL=y
CONFIG_PCIE_AL_INTERNAL=y

# ----------------------------------------------------------------------
# IRQ chip
# ----------------------------------------------------------------------
CONFIG_IRQCHIP=y
CONFIG_ARM_GIC=y
CONFIG_ARM_GIC_V3=y
CONFIG_ARM_GIC_V3_ITS=y
CONFIG_ARM_GIC_V3_ITS_PCI=y
CONFIG_ALPINE_MSI=y

# ----------------------------------------------------------------------
# DMA
# ----------------------------------------------------------------------
CONFIG_DMADEVICES=y
CONFIG_DMA_ENGINE=y
CONFIG_DMA_OF=y
CONFIG_ASYNC_TX_DMA=y

# ----------------------------------------------------------------------
# Clock
# ----------------------------------------------------------------------
CONFIG_COMMON_CLK=y
CONFIG_COMMON_CLK_VERSATILE=y
CONFIG_CLK_SP810=y

# Arch timer
CONFIG_ARM_ARCH_TIMER=y

# ----------------------------------------------------------------------
# PHY subsystem
# ----------------------------------------------------------------------
CONFIG_GENERIC_PHY=y

# ----------------------------------------------------------------------
# NVMEM
# ----------------------------------------------------------------------
CONFIG_NVMEM=y

# ----------------------------------------------------------------------
# Filesystems
# ----------------------------------------------------------------------

# ext4 (for eMMC partitions)
CONFIG_EXT4_FS=y
CONFIG_EXT4_USE_FOR_EXT2=y
CONFIG_EXT4_FS_POSIX_ACL=y
CONFIG_EXT4_FS_SECURITY=y

# Btrfs (for RAID data volumes)
CONFIG_BTRFS_FS=m

# squashfs (compatibility with stock firmware images)
CONFIG_SQUASHFS=m
CONFIG_SQUASHFS_FILE_DIRECT=y
CONFIG_SQUASHFS_DECOMP_MULTI_PERCPU=y
CONFIG_SQUASHFS_XATTR=y
CONFIG_SQUASHFS_ZLIB=y
CONFIG_SQUASHFS_ZSTD=y

# vfat (for USB sticks, data exchange)
CONFIG_VFAT_FS=m
CONFIG_FAT_DEFAULT_UTF8=y

# Overlay FS (for firmware layering)
CONFIG_OVERLAY_FS=y

# Pseudo filesystems
CONFIG_PROC_FS=y
CONFIG_PROC_SYSCTL=y
CONFIG_SYSFS=y
CONFIG_TMPFS=y
CONFIG_TMPFS_POSIX_ACL=y
CONFIG_TMPFS_XATTR=y
CONFIG_CONFIGFS_FS=y

# pstore / ramoops
CONFIG_PSTORE=y
CONFIG_PSTORE_CONSOLE=y
CONFIG_PSTORE_RAM=m

# NFS client (for network boot and debug)
CONFIG_NFS_FS=m
CONFIG_NFS_V3=m
CONFIG_NFS_V4=y
CONFIG_NFS_V4_1=y
CONFIG_NFS_V4_2=y

# NFS server (for serving files off NAS)
CONFIG_NFSD=m
CONFIG_NFSD_V4=y

# SMB/CIFS client (for Samba interop testing)
CONFIG_CIFS=m

# inotify / fanotify
CONFIG_INOTIFY_USER=y
CONFIG_FANOTIFY=y

# File locking (required for NFS/SMB)
CONFIG_FILE_LOCKING=y

# Quota support
CONFIG_QUOTA=y

# NLS (for CIFS/FAT)
CONFIG_NLS=y
CONFIG_NLS_DEFAULT="utf8"
CONFIG_NLS_CODEPAGE_437=m
CONFIG_NLS_ASCII=m
CONFIG_NLS_ISO8859_1=m
CONFIG_NLS_UTF8=m

# eCryptfs
CONFIG_ECRYPT_FS=m

# fuse (for userspace filesystems)
CONFIG_FUSE_FS=m

# ----------------------------------------------------------------------
# Security
# ----------------------------------------------------------------------
CONFIG_KEYS=y
CONFIG_ENCRYPTED_KEYS=y
CONFIG_SECURITY=y
CONFIG_SECURITYFS=y
CONFIG_HARDENED_USERCOPY=y
CONFIG_FORTIFY_SOURCE=y
CONFIG_SECURITY_DMESG_RESTRICT=y
CONFIG_SECCOMP=y

# LSM
CONFIG_LSM="landlock,lockdown,yama,integrity"

# ----------------------------------------------------------------------
# Crypto
# ----------------------------------------------------------------------
CONFIG_CRYPTO=y
CONFIG_CRYPTO_ALGAPI=y
CONFIG_CRYPTO_AEAD=y
CONFIG_CRYPTO_HASH=y
CONFIG_CRYPTO_RNG=y
CONFIG_CRYPTO_MANAGER=y
CONFIG_CRYPTO_NULL=y
CONFIG_CRYPTO_CRYPTD=y
CONFIG_CRYPTO_AUTHENC=y

# AEAD
CONFIG_CRYPTO_GCM=y
CONFIG_CRYPTO_CCM=y
CONFIG_CRYPTO_CHACHA20POLY1305=y
CONFIG_CRYPTO_SEQIV=y
CONFIG_CRYPTO_ECHAINIV=y

# Block modes
CONFIG_CRYPTO_CBC=y
CONFIG_CRYPTO_CTR=y
CONFIG_CRYPTO_ECB=y
CONFIG_CRYPTO_XTS=y

# Hash
CONFIG_CRYPTO_CMAC=y
CONFIG_CRYPTO_HMAC=y
CONFIG_CRYPTO_CRC32C=y
CONFIG_CRYPTO_CRCT10DIF=y
CONFIG_CRYPTO_GHASH=y
CONFIG_CRYPTO_SHA1=y
CONFIG_CRYPTO_SHA256=y
CONFIG_CRYPTO_SHA512=y
CONFIG_CRYPTO_MD5=y

# Ciphers
CONFIG_CRYPTO_AES=y
CONFIG_CRYPTO_DES=y

# Compression
CONFIG_CRYPTO_DEFLATE=y
CONFIG_CRYPTO_LZO=y
CONFIG_CRYPTO_ZSTD=y

# RNG
CONFIG_CRYPTO_DRBG_MENU=y
CONFIG_CRYPTO_DRBG_HMAC=y
CONFIG_CRYPTO_DRBG=y
CONFIG_CRYPTO_JITTERENTROPY=y

# RSA / ECDH (for kernel crypto, TLS, etc.)
CONFIG_CRYPTO_RSA=y
CONFIG_CRYPTO_ECDH=y

# ARM64 hardware crypto acceleration (Cortex-A57 supports ARMv8 CE)
CONFIG_CRYPTO_GHASH_ARM64_CE=y
CONFIG_CRYPTO_SHA1_ARM64_CE=y
CONFIG_CRYPTO_SHA2_ARM64_CE=y
CONFIG_CRYPTO_SHA256_ARM64=y
CONFIG_CRYPTO_SHA512_ARM64=y
CONFIG_CRYPTO_SHA512_ARM64_CE=y
CONFIG_CRYPTO_AES_ARM64=y
CONFIG_CRYPTO_AES_ARM64_CE=y
CONFIG_CRYPTO_AES_ARM64_CE_BLK=y
CONFIG_CRYPTO_AES_ARM64_CE_CCM=y
CONFIG_CRYPTO_AES_ARM64_BS=y
CONFIG_CRYPTO_AES_ARM64_NEON_BLK=y
CONFIG_CRYPTO_CHACHA20_NEON=y
CONFIG_CRYPTO_POLY1305_NEON=y
CONFIG_CRYPTO_CRCT10DIF_ARM64_CE=y

# User-space crypto API access (for dm-crypt, etc.)
CONFIG_CRYPTO_USER_API=y
CONFIG_CRYPTO_USER_API_HASH=y
CONFIG_CRYPTO_USER_API_SKCIPHER=y
CONFIG_CRYPTO_USER_API_AEAD=y

# ----------------------------------------------------------------------
# Kernel hardening
# ----------------------------------------------------------------------
CONFIG_STRICT_KERNEL_RWX=y
CONFIG_STRICT_MODULE_RWX=y

# ----------------------------------------------------------------------
# Things explicitly DISABLED
# ----------------------------------------------------------------------
# CONFIG_SOUND is not set
# CONFIG_DRM is not set
# CONFIG_FB is not set
# CONFIG_WIRELESS is not set
# CONFIG_CFG80211 is not set
# CONFIG_RFKILL is not set
# CONFIG_INFINIBAND is not set
# CONFIG_MEDIA_SUPPORT is not set
# CONFIG_ACCESSIBILITY is not set
# CONFIG_VIRTUALIZATION is not set
# CONFIG_XEN is not set
# CONFIG_STAGING is not set
# CONFIG_ACPI is not set
# CONFIG_EFI is not set
# CONFIG_NUMA is not set
# CONFIG_COMPAT is not set
# CONFIG_DEBUG_KERNEL is not set
# CONFIG_FTRACE is not set
# CONFIG_KPROBES is not set
# CONFIG_PROFILING is not set
CONFIG_PCI_HOST_GENERIC=y
CONFIG_ZONE_DMA32=y
```
